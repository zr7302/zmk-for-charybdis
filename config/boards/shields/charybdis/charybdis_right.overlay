/*
 * Copyright (c) 2020 ZMK Contributors
 *
 * SPDX-License-Identifier: MIT
 */
 
#include "charybdis.dtsi"

&default_transform {
    col-offset = <6>;
};

&kscan0 {
	col-gpios
		= <&gpio0 31 (GPIO_ACTIVE_HIGH | GPIO_PULL_DOWN)>
		, <&gpio0 29 (GPIO_ACTIVE_HIGH | GPIO_PULL_DOWN)>
		, <&gpio0 2 (GPIO_ACTIVE_HIGH | GPIO_PULL_DOWN)>
		, <&gpio1 15  (GPIO_ACTIVE_HIGH | GPIO_PULL_DOWN)>
		, <&gpio1 13 (GPIO_ACTIVE_HIGH | GPIO_PULL_DOWN)>
		, <&gpio1 11  (GPIO_ACTIVE_HIGH | GPIO_PULL_DOWN)>
		;
};

// trackball bus
&spi0 {
	status = "okay"; //okay
	sck-pin = <&gpio0 10 GPIO_ACTIVE_LOW>;
    mosi-pin = <&gpio0 9 GPIO_ACTIVE_LOW>;
    miso-pin = <&gpio0 9 GPIO_ACTIVE_LOW>;// same as mosi (3-wire spi)
	cs-gpios = <&gpio0 24 GPIO_ACTIVE_LOW>;
};

&trackball {
	status = "okay"; //okay
	irq-gpios = <&gpio0 11 (GPIO_ACTIVE_LOW | GPIO_PULL_UP)>;
};
